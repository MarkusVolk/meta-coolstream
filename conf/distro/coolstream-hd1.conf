## conf/distro/coolstream-hd1.conf
```bitbake
include conf/distro/include/coolstream-hd1/default-providers.inc
include conf/distro/include/coolstream-hd1/default-versions.inc
include conf/distro/include/coolstream-hd1/default-distrovars.inc
include conf/distro/include/coolstream-hd1/default-rdepends.inc
include conf/distro/include/coolstream-hd1/${IMAGETYPE}.inc
include conf/distro/include/coolstream-hd1/world-broken.inc
include conf/distro/include/coolstream-hd1/as-needed.inc

TCMODE ?= "default"
require conf/distro/include/coolstream-hd1/tcmode-${TCMODE}.inc

TCLIBC = "glibc"
require conf/distro/include/coolstream-hd1/tclibc-${TCLIBC}.inc

# Allow single libc distros to disable this code
#TCLIBCAPPEND ?= "-${TCLIBC}"
#TMPDIR .= "${TCLIBCAPPEND}"

CACHE = "${TMPDIR}/cache/${TCMODE}-${TCLIBC}${@['', '/' + str(d.getVar('MACHINE', True))][bool(d.getVar('MACHINE', True))]}${@['', '/' + str(d.getVar('SDKMACHINE', True))][bool(d.getVar('SDKMACHINE', True))]}"

USER_CLASSES ?= ""
PACKAGE_CLASSES ?= "package_ipk"
INHERIT_BLACKLIST = "blacklist"
INHERIT_DISTRO ?= "debian devshell sstate license"
INHERIT += "${PACKAGE_CLASSES} ${USER_CLASSES} ${INHERIT_DISTRO} ${INHERIT_BLACKLIST}"
```

## conf/distro/coolstream-hd2.conf
```bitbake
include conf/distro/include/coolstream-hd2/default-providers.inc
include conf/distro/include/coolstream-hd2/default-versions.inc
include conf/distro/include/coolstream-hd2/default-distrovars.inc
include conf/distro/include/coolstream-hd2/default-rdepends.inc
include conf/distro/include/coolstream-hd2/${IMAGETYPE}.inc
include conf/distro/include/coolstream-hd2/world-broken.inc

TCMODE ?= "default"
require conf/distro/include/coolstream-hd2/tcmode-${TCMODE}.inc

TCLIBC ?= "uclibc"
require conf/distro/include/coolstream-hd2/tclibc-${TCLIBC}.inc

# Allow single libc distros to disable this code
#TCLIBCAPPEND ?= "-${TCLIBC}"
#TMPDIR .= "${TCLIBCAPPEND}"

CACHE = "${TMPDIR}/cache/${TCMODE}-${TCLIBC}${@['', '/' + str(d.getVar('MACHINE', True))][bool(d.getVar('MACHINE', True))]}${@['', '/' + str(d.getVar('SDKMACHINE', True))][bool(d.getVar('SDKMACHINE', True))]}"

USER_CLASSES ?= ""
PACKAGE_CLASSES ?= "package_ipk"
INHERIT_BLACKLIST = "blacklist"
INHERIT_DISTRO ?= "debian devshell sstate license"
INHERIT += "${PACKAGE_CLASSES} ${USER_CLASSES} ${INHERIT_DISTRO} ${INHERIT_BLACKLIST}"
```

## conf/distro/include/coolstream-hd1/default-rdepends.inc
```bitbake
RDEPENDS_groff ?= "sed"
RDEPENDS_winbind ?= "popt libpam"
RDEPENDS_libwinbind ?= "libpam"
RDEPENDS_swat ?= "popt libpam"
RDEPENDS_samba ?= "popt libpam"
RDEPENDS_busybox ?= "libpam"
RDEPENDS_neutrino-hd ?= "luaposix tzdata cs-drivers-hd2"
RDEPENDS_neutrino-mp ?= "luaposix tzdata cs-drivers-hd2"
```

## conf/distro/include/coolstream-hd1_flash/default-rdepends.inc
```bitbake
RDEPENDS_neutrino-hd ?= "luaposix tzdata cs-drivers-hd1 resolvconf"
RDEPENDS_neutrino-mp ?= "luaposix tzdata cs-drivers-hd1 resolvconf"
RDEPENDS_oscam ?= "cs-drivers-hd1"
```

## conf/distro/include/coolstream-hd1_flash/default-versions.inc
```bitbake
#
# Default preferred versions
#
# currently usable kernel version, use the same for headers
LINUXLIBCVERSION ?= "2.6.34%"
PREFERRED_VERSION_linux-libc-headers = "3.10.70"
PREFERRED_VERSION_nativesdk-linux-libc-headers = "3.10.70"
PREFERRED_VERSION_ffmpeg = "2.3.3%"
PREFERRED_VERSION_luaposix = "31"
# Force the python versions in one place
PYTHON_BASEVERSION ?= "2.7"
PREFERRED_VERSION_python ?= "2.7.9"
PREFERRED_VERSION_python-native ?= "2.7.9"

# Force the older version of liberation-fonts until we fix the fontforge issue
PREFERRED_VERSION_liberation-fonts ?= "1.04"
```

## conf/distro/include/coolstream-hd2/default-rdepends-glibc.inc
```bitbake
RDEPENDS_winbind ?= "popt libpam"
RDEPENDS_libwinbind ?= "libpam"
RDEPENDS_swat ?= "popt libpam"
RDEPENDS_samba ?= "popt libpam"
RDEPENDS_busybox ?= "libpam"
RDEPENDS_neutrino-hd ?= "luaposix tzdata cs-drivers-hd2 resolvconf"
RDEPENDS_neutrino-mp ?= "luaposix tzdata cs-drivers-hd2 resolvconf"
RDEPENDS_oscam ?= "cs-drivers-hd2"
```

## conf/distro/include/coolstream-hd2/default-rdepends-uclibc.inc
```bitbake
RDEPENDS_vim ?= "libiconv gettext-runtime"
RDEPENDS_fuse ?= "libiconv"
RDEPENDS_djmount ?= "fuse libiconv"
DEPENDS_groff ?= "libiconv"
RDEPENDS_${PN}_groff ?= "libiconv sed"
RDEPENDS_winbind ?= "popt libpam"
RDEPENDS_libwinbind ?= "libpam"
RDEPENDS_swat ?= "popt libpam"
RDEPENDS_samba_${PN} ?= "popt libpam libtdb openldap"
RDEPENDS_tar ?= "libiconv"
RDEPENDS_grep ?= "libiconv"
RDEPENDS_basefiles ?= "libiconv"
RDEPENDS_git ?= "libiconv"
RDEPENDS_gnutls-xx ?= "libiconv gettext-runtime"
RDEPENDS_gnutls-openssl ?= "libiconv gettext-runtime"
RDEPENDS_popt ?= "libiconv"
RDEPENDS_gnutls ?= "libiconv gettext-runtime"
RDEPENDS_busybox ?= "libpam"
RDEPENDS_libxml2 ?= "libiconv"
RDEPENDS_ffmpeg ?= "libiconv"
RDEPENDS_flac ?= "libiconv"
RDEPENDS_libcurl ?= "libiconv gettext-runtime"
RDEPENDS_tar ?= "libiconv"
RDEPENDS_neutrino-hd ?= "luaposix tzdata cs-drivers-hd2 resolvconf"
RDEPENDS_neutrino-mp ?= "luaposix tzdata cs-drivers-hd2 resolvconf"
RDEPENDS_oscam ?= "cs-drivers-hd2"
```

## conf/distro/include/coolstream-hd2/default-versions.inc
```bitbake
#
# Default preferred versions
#
# currently usable kernel version, use the same for headers
KV = "3.10.70"
LINUXLIBCVERSION ?= "${KV}"
PREFERRED_VERSION_ffmpeg = "2.3.3%"
PREFERRED_VERSION_luaposix = "31"
# Force the python versions in one place
PYTHON_BASEVERSION ?= "2.7"
PREFERRED_VERSION_python ?= "2.7.9"
PREFERRED_VERSION_python-native ?= "2.7.9"

# Force the older version of liberation-fonts until we fix the fontforge issue
PREFERRED_VERSION_liberation-fonts ?= "1.04"
```

## conf/layer.conf
```bitbake
# We have a conf and classes directory, append to BBPATH
BBPATH .= ":${LAYERDIR}"

# We have a recipes directory containing .bb and .bbappend files, add to BBFILES
BBFILES += "${LAYERDIR}/recipes*/*/*.bb \
	    ${LAYERDIR}/recipes*/*/*/*.bb \
            ${LAYERDIR}/recipes*/*/*.bbappend"

BBFILE_COLLECTIONS += "coolstream-hd1 coolstream-hd2"
BBFILE_PATTERN_coolstream-hd1 := "^${LAYERDIR}/"
BBFILE_PRIORITY_coolstream-hd1 = "6"
BBFILE_PATTERN_coolstream-hd2 := "^${LAYERDIR}/"
BBFILE_PRIORITY_coolstream-hd2 = "6"

# Additional license directories.
LICENSE_PATH += "${LAYERDIR}/files/custom-licenses"
```

## conf/machine/coolstream-hd1.conf
```bitbake
#@TYPE: Machine
#@NAME: Coolstream HD1 Set Top Box
#@DESCRIPTION: Machine configuration for the Coolstream HD1 (HD1, Neo, Neo2, Zee) Boxes
#@MAINTAINER: Stefan Seyfried

include conf/machine/include/coolstream-hd1/hd1-default-settings.inc
require conf/machine/include/coolstream-hd1/tune-coolstream-hd1.inc

IMAGE_FSTYPES ?= "ext3 jffs2.sum usbimg"

SERIAL_CONSOLE = "115200 ttyRI0"

MACHINE_KERNEL_PR = "r0"

PACKAGE_EXTRA_ARCHS  = "armv6"

KERNEL_IMAGETYPE = "zImage"

MACHINE_FEATURES = "kernel26 apm usbhost keyboard vfat ext2 wifi"

#HD1 has no hardware clock
MACHINE_FEATURES_BACKFILL_CONSIDERED = "rtc"

MACHINE_EXTRA_RRECOMMENDS += " \
	kernel-modules \
"
DISTRO ?= "${@'${MACHINE}' if IMAGETYPE != 'tiny' else '${MACHINE}_flash'}"     
DISTRO_VERSION ?= "master"
RELEASE_STATE ?= "1"
DISTRO_VERSION_NUMBER_MAJOR ?= "2"
DISTRO_VERSION_NUMBER_MINOR ?= "1"
DISTRO_VERSION_NUMBER ?= "${DISTRO_VERSION_NUMBER_MAJOR}.${DISTRO_VERSION_NUMBER_MINOR}"
```

## conf/machine/coolstream-hd2.conf
```bitbake
#@TYPE: Machine
#@NAME: Coolstream HD2 Set Top Box
#@DESCRIPTION: Machine configuration for the Coolstream HD2 (Tank, Trinity, Zee2) Boxes
#@MAINTAINER: Markus Volk

include conf/machine/include/coolstream-hd2/hd2-default-settings.inc
include conf/machine/include/coolstream-hd2/tune-coolstream-hd2.inc


IMAGE_FSTYPES ?= "jffs2.sum"

SERIAL_CONSOLE = "115200 ttyS0"

MACHINE_KERNEL_PR = "r0"

PACKAGE_EXTRA_ARCHS  = "cortexa9hf-vfp"

KERNEL_IMAGETYPE = "zImage"

MACHINE_FEATURES = "apm usbhost keyboard vfat ext2 wifi"

# Coolstream Hardware has no hardware clock
MACHINE_FEATURES_BACKFILL_CONSIDERED = "rtc"

MACHINE_EXTRA_RRECOMMENDS += " \
	kernel-modules \
"

DISTRO ?= "${MACHINE}"     
DISTRO_VERSION ?= "krogoth"
RELEASE_STATE ?= "1"
DISTRO_VERSION_NUMBER_MAJOR ?= "2"
DISTRO_VERSION_NUMBER_MINOR ?= "1"
DISTRO_VERSION_NUMBER ?= "${DISTRO_VERSION_NUMBER_MAJOR}.${DISTRO_VERSION_NUMBER_MINOR}"

TARGET_CFLAGS += "-Os"
```

## conf/machine/include/coolstream-hd2/hd2-default-settings.inc
```bitbake
# Coolstream HD2 BSP default settings

IMAGE_CLASSES += "usb_image-hd2"

JFFS2_ERASEBLOCK = "${@'0x20000' if BOXMODEL != 'tank' else '0x40000'}"
JFFS2_SUM_EXTRA_ARGS = "-e ${JFFS2_ERASEBLOCK} -n -l"
EXTRA_IMAGECMD_jffs2 = "-e ${JFFS2_ERASEBLOCK} -n -l -U"
```

## conf/machine/include/coolstream-hd2/tune-coolstream-hd2.inc
```bitbake
TARGET_ARCH = "arm"

DEFAULTTUNE ?= "cortexa9hf-vfpv3"

require conf/machine/include/tune-cortexa9.inc

PACKAGE_EXTRA_ARCHS  = "cortexa9hf-vfpv3"
```

## conf/machine/include/hd1-default-providers.inc
```bitbake
# Coolstream HD1 BSP default providers

PREFERRED_PROVIDER_virtual/kernel = "linux-hd1"
PREFERRED_PROVIDER_virtual/xserver = "none"
PREFERRED_PROVIDER_virtual/stb-hal-libs = "cs-drivers-hd1"
PREFERRED_PROVIDER_virtual/libiconv = "glibc"
PREFERRED_PROVIDER_ffmpeg = "ffmpeg"
PREFERRED_PROVIDER_jpeg-native = "libjpeg-turbo-native"
```

## conf/machine/include/hd1-default-versions.inc
```bitbake
# Coolstream HD1 BSP default versions

# "upstream" also uses 4.8
GCCVERSION ?= "4.8%"

# currently usable kernel version, use the same for headers
LINUXLIBCVERSION ?= "2.6.34%"

PREFERRED_VERSION_nativesdk-linux-libc-headers = "3.14"

PREFERRED_VERSION_ffmpeg = "2.3.3%"

PREFERRED_VERSION_luaposix = "31"
```

## conf/machine/include/hd2-default-providers.inc
```bitbake
# Coolstream HD2 BSP default providers

PREFERRED_PROVIDER_virtual/kernel = "linux-hd2"
PREFERRED_PROVIDER_virtual/xserver = "none"
PREFERRED_PROVIDER_virtual/stb-hal-libs = "cs-drivers-hd2"
PREFERRED_PROVIDER_ffmpeg = "ffmpeg"
PREFERRED_PROVIDER_jpeg-native = "libjpeg-turbo-native"
```

## conf/machine/include/hd2-default-versions.inc
```bitbake
# Coolstream HD2 BSP default versions

# "upstream" also uses 4.8
GCCVERSION ?= "4.8%"

# set udev to 164 because the cst kernel lacks devtmpfs support 
PREFERRED_VERSION_udev = "164"

# currently usable kernel version, use the same for headers
LINUXLIBCVERSION ?= "2.6.34%"

PREFERRED_VERSION_nativesdk-linux-libc-headers = "3.16%"

PREFERRED_VERSION_ffmpeg = "2.3.3%"

PREFERRED_VERSION_luaposix = "31"
```
